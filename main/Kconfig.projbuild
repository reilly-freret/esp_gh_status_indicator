## main/Kconfig.projbuild
```kconfig
menu "GitHub Status Indicator Configuration"

    config USE_VERCEL
        bool "use vercel instead of github for deployment status"
        default true

    config GITHUB_USERNAME
        string "GitHub Username"
        default "octocat"
        help
            GitHub username to check status for

    config GITHUB_REPO
        string "GitHub Repository"
        default "octocat/Hello-World"
        help
            GitHub repository to check status for (format: owner/repo)

    config GITHUB_AUTH_TOKEN
        string "Github personal auth token"
        default "CHANGE_ME"

    config VERCEL_AUTH_TOKEN
        string "Vercel personal auth token"
        default "CHANGE_ME"

    config VERCEL_TEAM_ID
        string "Vercel Team ID"
        default "CHANGE_ME"
        help
            Vercel team ID for API requests

    config VERCEL_PROJECT_ID
        string "Vercel Project ID"
        default "CHANGE_ME"
        help
            Vercel project ID for API requests

    config STATUS_CHECK_INTERVAL
        int "Status Check Interval (seconds)"
        range 10 3600
        default 60
        help
            How often to check GitHub status in seconds

    config WIFI_SSID
        string "WiFi SSID"
        default "myssid"
        help
            WiFi network name

    config WIFI_PASSWORD
        string "WiFi Password"
        default "mypassword"
        help
            WiFi password
    
    config MIKES_WAY
        bool "Mike's way"
        default false
        help
            when true, applies 180-deg rotation and offset

    config BOTTOM_TEXT_HEIGHT
        int "bottom text area height"
        default 30

    config SNTP_SERVER
        string "SNTP Server"
        default "pool.ntp.org"
        help
            SNTP server for time synchronization

    config SNTP_SYNC_TIMEOUT
        int "SNTP Sync Timeout (seconds)"
        range 5 60
        default 10
        help
            Timeout for SNTP synchronization in seconds

    config TZ_OFFSET
        int "timezone offset (e.g. NYC = -4)"
        default -4

endmenu
```
